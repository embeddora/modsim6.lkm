## Kconfig
```kconfig
#
# Copyright (c) 2021 Embeddora LLC konstantin.mauch@embeddora.com All rights reserved
#
# Redistribution and use in source and binary forms, with or without
# modification, are permitted provided that the following conditions are met:
#       * Redistributions of source code must retain the above copyright
#          notice, this list of conditions and the following disclaimer.
#       # Redistributions in binary form must reproduce the above copyright
#       *  notice, this list of conditions and the following disclaimer in the
#          documentation and/or other materials provided with the distribution.
#       * Neither the name of The Linux Foundation nor
#          the names of its contributors may be used to endorse or promote
#          products derived from this software without specific prior written
#          permission.
#
# THIS SOFTWARE IS PROVIDED BY THE COPYRIGHT HOLDERS AND CONTRIBUTORS "AS IS"
# AND ANY EXPRESS OR IMPLIED WARRANTIES, INCLUDING, BUT NOT LIMITED TO, THE
# IMPLIED WARRANTIES OF MERCHANTABILITY, FITNESS FOR A PARTICULAR PURPOSE AND
# NON-INFRINGEMENT ARE DISCLAIMED.    IN NO EVENT SHALL THE COPYRIGHT OWNER OR
# CONTRIBUTORS BE LIABLE FOR ANY DIRECT, INDIRECT, INCIDENTAL, SPECIAL,
# EXEMPLARY, OR CONSEQUENTIAL DAMAGES (INCLUDING, BUT NOT LIMITED TO,
# PROCUREMENT OF SUBSTITUTE GOODS OR SERVICES; LOSS OF USE, DATA, OR PROFITS;
# OR BUSINESS INTERRUPTION) HOWEVER CAUSED AND ON ANY THEORY OF LIABILITY,
# WHETHER IN CONTRACT, STRICT LIABILITY, OR TORT (INCLUDING NEGLIGENCE OR
# OTHERWISE) ARISING IN ANY WAY OUT OF THE USE OF THIS SOFTWARE, EVEN IF
# ADVISED OF THE POSSIBILITY OF SUCH DAMAGE.
#
# Abstract: we all but me are made of stars.
#                         ___
#                        ',_`""\        .---,
#                           \   :-""``/`    |
#                            `;'     //`\   /
#                            /   __     |   ('.
#                           |_ ./O)\     \  `) \
#                          _/-.    `      `"`  |`.
#                      .-=; `                  /  ;.
#                     /o o \   ,_,           .'  '  ;
#                     L._._;_.-'           .'   '   ;'
#                       `'-.`           .-'        ,
#                           `.        .'       ..;'
#                             '-._. -'     ..-'
#                              ./, \ ...--'
#                            ,',\../',
#                          ," ` /. .  ;
#                          :   ; :  : :
#                          `.,'  `,   ;
#                           "     :   :
#                                  ",'
#

menuconfig W1
	tristate "Dallas's 1-wire support"
	depends on HAS_IOMEM
	---help---
	  Dallas' 1-wire bus is useful to connect slow 1-pin devices
	  such as iButtons and thermal sensors.

	  If you want W1 support, you should say Y here.

	  This W1 support can also be built as a module.  If so, the module
	  will be called wire.

if W1

config W1_CON
	depends on CONNECTOR
	bool "Userspace communication over connector"
	default y
	---help---
	  This allows to communicate with userspace using connector. For more
	  information see <file:Documentation/connector/connector.txt>.
	  There are three types of messages between w1 core and userspace:
	  1. Events. They are generated each time new master or slave device found
		either due to automatic or requested search.
	  2. Userspace commands. Includes read/write and search/alarm search commands.
	  3. Replies to userspace commands.

source drivers/w1/masters/Kconfig
source drivers/w1/slaves/Kconfig

endif # W1
```
